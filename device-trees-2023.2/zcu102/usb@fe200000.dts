/dts-v1/;

/ {
	#address-cells = <0x02>;
	#size-cells = <0x02>;

	passthrough {
		compatible = "simple-bus";
		ranges;
		#address-cells = <0x02>;
		#size-cells = <0x02>;

		clk: clk {
			#clock-cells = <0x0>;
			clock-frequency = <0xee6b280>;
			compatible = "fixed-clock";
		};

		dwc3_0: usb@fe200000 {
			maximum-speed = "super-speed";
			snps,usb3_lpm_capable;
			dr_mode = "host";
			clocks = <&clk>;
			snps,resume-hs-terminations;
			snps,enable_guctl1_ipd_quirk;
			clock-names = "ref";
			snps,quirk-frame-length-adjustment = <0x20>;
			interrupts = <0x00 0x41 0x04 0x00 0x45 0x04 0x00 0x4b 0x04>;
			interrupt-names = "dwc_usb3", "otg", "hiber";
			interrupt-parent = <0xfde8>;
			reg = <0x00 0xfe200000 0x00 0x40000>;
			status = "okay";
			compatible = "snps,dwc3";
			xen,path = "/axi/usb@ff9d0000/usb@fe200000";
			xen,reg = <0x00 0xfe200000 0x00 0x40000 0x00 0xfe200000>;
		};
	};
};
