/dts-v1/;

/ {
	#address-cells = <0x2>;
	#size-cells = <0x2>;

	passthrough {
		compatible = "simple-bus";
		ranges;
		#address-cells = <0x2>;
		#size-cells = <0x2>;

		/* timer has been tested with baremetal app only */
		timer@ff110000 {
			compatible = "cdns,ttc";
			status = "okay";
			interrupt-parent = <0xfde8>;
			interrupts = <0x0 0x24 0x4 0x0 0x25 0x4 0x0 0x26 0x4>;
			reg = <0x0 0xff110000 0x0 0x1000>;
			timer-width = <0x20>;
			xen,force-assign-without-iommu = <1>;
			xen,reg = <0x0 0xff110000 0x0 0x1000 0x0 0xff110000>;
			xen,path = "/axi/timer@ff110000";
		};
	};
};
