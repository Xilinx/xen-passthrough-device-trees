/dts-v1/;

/ {
	#address-cells = <0x02>;
	#size-cells = <0x02>;

	passthrough {
		compatible = "simple-bus";
		ranges;
		#address-cells = <0x02>;
		#size-cells = <0x02>;

		ahci@fd0c0000 {
			compatible = "ceva,ahci-1v84";
			status = "okay";
			reg = <0x00 0xfd0c0000 0x00 0x2000>;
			interrupt-parent = <0xfde8>;
			interrupts = <0x00 0x85 0x04>;
			ceva,p0-cominit-params = <0x18401828>;
			ceva,p0-comwake-params = <0x614080e>;
			ceva,p0-burst-params = <0x13084a06>;
			ceva,p0-retry-params = <0x96a43ffc>;
			ceva,p1-cominit-params = <0x18401828>;
			ceva,p1-comwake-params = <0x614080e>;
			ceva,p1-burst-params = <0x13084a06>;
			ceva,p1-retry-params = <0x96a43ffc>;
			xlnx,tz-nonsecure-sata0 = <0x00>;
			xlnx,tz-nonsecure-sata1 = <0x00>;
			phandle = <0x60>;
			xen,reg = <0x00 0xfd0c0000 0x00 0x2000 0x00 0xfd0c0000>;
			xen,path = "/axi/ahci@fd0c0000";
		};
	};
};
